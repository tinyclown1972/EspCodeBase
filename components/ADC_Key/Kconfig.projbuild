## components/ADC_Key/Kconfig.projbuild
```kconfig
menu "ADC_KEY Configuration"

    config ADC_KEY_ENABLE
        bool "Enable ADC_KEY component"
        default false
        help
            if to Enable ADC_KEY component.

endmenu
```

## components/GUI/Kconfig.projbuild
```kconfig
menu "SimpleGUI Configuration"

    config SIMPLE_GUI_ENABLE
        bool "Enable SipleGUI component"
        default false
        help
            if to Enable SipleGUI component.

    config SGUI_GET_POINT_FUNC_EN
        depends on SIMPLE_GUI_ENABLE
        bool "Enable Get point function"
        default false
        help
            if to Enable SGUI Get point function.
endmenu
```

## components/MyGpio/Kconfig.projbuild
```kconfig
menu "MgGpio Configuration"

    config MYGPIO_EN
        bool "Enable MyGpio component"
        default false
        help
            if to Enable MyGpio component.

    config ESP32_C3_LED_ENABLE
        bool "Enable ESP32 C3 2 LED control"
        default false
        help
            if to Enable control default 2 board LED.
endmenu
```

## components/MyMDns/Kconfig.projbuild
```kconfig
menu "mDns Configuration"

    config M_DNS_EN
        bool "Enable mDns component"
        default false
        help
            if to Enable mDns component.

endmenu
```

## components/MyOTA/Kconfig.projbuild
```kconfig
menu "OTA Configuration"

    config OTA_EN
        bool "Enable OTA component"
        default false
        help
            if to Enable OTA component.

endmenu
```

## components/MyWeb/Kconfig.projbuild
```kconfig
menu "Web Configuration"

    config WEB_EN
        bool "Enable Web component"
        default false
        help
            if to Enable Web component.

endmenu
```

## components/MyWiFi/Kconfig.projbuild
```kconfig
menu "WiFi Configuration"

    config WiFi_EN
        bool "Enable WiFi component"
        default false
        help
            if to Enable WiFi component.

    config WiFi_SSID
        depends on WiFi_EN
        string "WiFi SSID to connect"
        default ""
        help
            WiFi SSID to connect

    config WiFi_PWD
        depends on WiFi_EN
        string "WiFi Password to connect"
        default ""
        help
            WiFi Password to connect

    config WiFi_RETRY
        depends on WiFi_EN
        int "WiFi connect Retry time"
        default 5
        help
            WiFi connect Retry time

endmenu
```

## components/Pump/Kconfig.projbuild
```kconfig
menu "Pump Configuration"

    config PUMP_EN
        bool "Enable Pump component"
        default false
        help
            if to Enable Pump component.

endmenu
```

## components/RTE/Kconfig.projbuild
```kconfig
menu "RTE Configuration"

    config RTE_EN
        bool "Enable RTE component"
        default false
        help
            if to Enable RTE component.

endmenu
```

## components/SR04/Kconfig.projbuild
```kconfig
menu "SR04 Configuration"

    config SR04_EN
        bool "Enable SR04 component"
        default false
        help
            if to Enable SR04 component.

endmenu
```

## components/Utils/Kconfig.projbuild
```kconfig
menu "Utils Configuration"

    config UTILS_EN
        bool "Enable Utils component"
        default false
        help
            if to Enable Utils component.

endmenu
```

## components/u8g2/Kconfig.projbuild
```kconfig
menu "U8g2 Configuration"

    config U8G2_ENABLE
        bool "Enable U8g2 component"
        default false
        help
            if to Enable U8g2 component.

    config U8G2_SCL_GPIO
        depends on U8G2_ENABLE
        int "SCL GPIO number"
        range 0 GPIO_RANGE_MAX
        default 22 if IDF_TARGET_ESP32
        default  2 if IDF_TARGET_ESP32S2 || IDF_TARGET_ESP32S3
        default  2 if IDF_TARGET_ESP32H2
        default  5 # C3 and others
        help
            GPIO number (IOxx) to I2C SCL.
            Some GPIOs are used for other purposes (flash connections, etc.) and cannot be used to I2C.
            GPIOs 35-39 are input-only so cannot be used as outputs.

    config U8G2_SDA_GPIO
        depends on U8G2_ENABLE
        int "SDA GPIO number"
        range 0 GPIO_RANGE_MAX
        default 21 if IDF_TARGET_ESP32
        default  1 if IDF_TARGET_ESP32S2 || IDF_TARGET_ESP32S3
        default  1 if IDF_TARGET_ESP32H2
        default  4 # C3 and others
        help
            GPIO number (IOxx) to I2C SDA.
            Some GPIOs are used for other purposes (flash connections, etc.) and cannot be used to I2C.
            GPIOs 35-39 are input-only so cannot be used as outputs.

    config U8G2_RESET_GPIO
        depends on U8G2_ENABLE
        int "RESET GPIO number"
        range -1 GPIO_RANGE_MAX
        default 15 if IDF_TARGET_ESP32
        default 38 if IDF_TARGET_ESP32S2 || IDF_TARGET_ESP32S3
        default  -1 # C3 and others
        help
            GPIO number (IOxx) to RESET.
            When it is -1, RESET isn't performed.
            Some GPIOs are used for other purposes (flash connections, etc.) and cannot be used to RESET.
            GPIOs 35-39 are input-only so cannot be used as outputs.

    choice U8G2_I2C_PORT
        depends on U8G2_ENABLE
        prompt "I2C port that controls this bus"
        default I2C_PORT_0
        help
            Select I2C port that controls this bus.
        config I2C_PORT_0
            bool "I2C_PORT_0"
            help
                Use I2C_PORT_0.
        config I2C_PORT_1
            depends on IDF_TARGET_ARCH_XTENSA
            bool "I2C_PORT_1"
            help
                Use I2C_PORT_1.
    endchoice
endmenu
```
